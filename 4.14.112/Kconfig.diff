## 4.14.112/Kconfig.diff
```kconfig
diff --git a/drivers/tty/Kconfig b/drivers/tty/Kconfig
index 22c825928b7a..43c553eeede6 100644
--- a/drivers/tty/Kconfig
+++ b/drivers/tty/Kconfig
@@ -471,6 +471,29 @@ config VCC
 	help
 	  Support for Sun logical domain consoles.
 
+config LDISC_AUTOLOAD
+	bool "Automatically load TTY Line Disciplines"
+	default y
+	help
+	  Historically the kernel has always automatically loaded any
+	  line discipline that is in a kernel module when a user asks
+	  for it to be loaded with the TIOCSETD ioctl, or through other
+	  means.  This is not always the best thing to do on systems
+	  where you know you will not be using some of the more
+	  "ancient" line disciplines, so prevent the kernel from doing
+	  this unless the request is coming from a process with the
+	  CAP_SYS_MODULE permissions.
+
+	  Say 'Y' here if you trust your userspace users to do the right
+	  thing, or if you have only provided the line disciplines that
+	  you know you will be using, or if you wish to continue to use
+	  the traditional method of on-demand loading of these modules
+	  by any user.
+
+	  This functionality can be changed at runtime with the
+	  dev.tty.ldisc_autoload sysctl, this configuration option will
+	  only set the default value of this functionality.
+
 config OKL4_VTTY
 	bool "Virtual TTY on the OKL4 Microvisor"
 	depends on OKL4_GUEST
```
